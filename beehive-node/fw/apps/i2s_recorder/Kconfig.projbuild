## beehive-node/fw/apps/i2s_recorder/Kconfig.projbuild
```kconfig
menu "I2S Recorder Configuration"
    config EXAMPLE_REC_TIME
        int "Example Recording Time in Seconds"
        default 15
        help
            Set the time for recording audio in seconds.
endmenu
```

## beehive-node/fw/components/node_i2s_pdm_mic/Kconfig.projbuild
```kconfig
menu "I2S MEMS MIC pinout Configuration"

    config EXAMPLE_SAMPLE_RATE
        int "Audio Sample Rate"
        default 44100
        help
            Set the audio sample rate frequency. Usually 16000 or 44100 Hz.

    config EXAMPLE_BIT_SAMPLE
        int "Audio Bit Sample"
        default 16
        help
            Define the number of bits for each sample. Default 16 bits per sample.

    config EXAMPLE_I2S_DATA_GPIO
        int "I2S Data GPIO"
        default 5
        help
            Set the GPIO number used for transmitting/receiving data from I2S.

    config EXAMPLE_I2S_CLK_GPIO
        int "I2S Clock GPIO"
        default 4
        help
            Set the GPIO number used for the clock line from I2S.

endmenu
```

## beehive-node/fw/middleware/node_dht/Kconfig.projbuild
```kconfig
menu "DHT Middleware pinout configuration"
    config NODE_DHT_GPIO
        int "GPIO number"
        default 4
        help
            GPIO number where the DHT data pin is connected.
            This GPIO will be used for both input and output.
            Make sure to connect a pull-up resistor (4.7k-10k) between
            the data pin and VCC.
endmenu
```
